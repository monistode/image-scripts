/dts-v1/;
/plugin/;

/{
	fragment@0 {
    	target-path = "/soc/base_fpga_region";
        __overlay__ {
	    #address-cells = <1>;
            #size-cells = <1>;
            firmware-name = "accum.rbf";
        };
    };
};
